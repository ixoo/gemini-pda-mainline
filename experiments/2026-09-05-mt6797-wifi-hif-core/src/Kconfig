## experiments/2026-09-05-mt6797-wifi-hif-core/src/Kconfig
```kconfig
# SPDX-License-Identifier: GPL-2.0-only
config MT6797_HIF_CORE
	bool "MT6797 private WLAN HIF transport core"
	depends on ARM64 && COMPILE_TEST
	default n
	help
	  Build the private ordered AHB transport and bounded ordinary INIT
	  section implementation. There is no platform probe or runtime caller
	  until a real CONSYS owner supplies the required powered mapping and
	  exclusion. This option does not provide a usable Wi-Fi device.
```

## experiments/2026-09-05-mt6797-wifi-kernel-compile/src/Kconfig
```kconfig
# SPDX-License-Identifier: GPL-2.0-only
config MT6797_HIF_COMPILE_TEST
	bool "Compile MT6797 HIF protocol and MMIO boundary"
	depends on ARM64 && COMPILE_TEST
	default n
	help
	  Compile the experimental PIO/INIT/ordinary-section components with
	  ordered Linux MMIO accessors. This registers no device, runs no test
	  at boot and provides no operational Wi-Fi driver. It acquires no
	  resources and never enables a connectivity power domain.
	  Say N normally.
```
