/dts-v1/;
/plugin/;

/ {
	fragment@0 {
		target-path = "/t-phy@11290000";

		__overlay__ {
			status = "okay";
		};
	};

	fragment@1 {
		target-path = "/t-phy@11290000/usb-phy@11290800";

		__overlay__ {
			status = "okay";
		};
	};

	fragment@2 {
		target-path = "/usb@11271000";

		__overlay__ {
			status = "okay";
		};
	};
};
